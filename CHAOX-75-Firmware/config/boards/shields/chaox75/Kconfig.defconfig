## Firmware/zmk-config/config/boards/shields/custom_dongle/Kconfig.defconfig
```kconfig
if SHIELD_CUSTOM_DONGLE

config ZMK_KEYBOARD_NAME
    default "Dongle Receiver"

# Central role for wireless peripheral
config ZMK_SPLIT_BLE_ROLE_CENTRAL
    default y

config ZMK_SPLIT
    default y

endif
```
